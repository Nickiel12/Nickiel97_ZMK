## boards/shields/nickiel97/Kconfig.defconfig
```kconfig
if SHIELD_NICKIEL97

  config ZMK_KEYBOARD_NAME
    default "Nickiel 97"

  config ZMK_KSCAN_MATRIX_POLLING
  	default y

  config ZMK_STUDIO
	default y

  config ZMK_SLEEP
	  default n

  config ZMK_EXT_POWER
	  default n

endif
```
